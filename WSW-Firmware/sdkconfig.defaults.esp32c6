## WSW-Firmware/sdkconfig.defaults.esp32c6
```kconfig
# ─────────────────────────────────────────────────────────────────────────────
# Westshore Drone Remote ID Receiver — sdkconfig.defaults.esp32c6
# Target-specific overrides for ESP32-C6-WROOM-1U-N4.
# Shared settings live in sdkconfig.defaults.
# ─────────────────────────────────────────────────────────────────────────────

CONFIG_IDF_TARGET="esp32c6"

# 4 MB flash on N4 module
CONFIG_ESPTOOLPY_FLASHSIZE_4MB=y
CONFIG_ESPTOOLPY_FLASHSIZE="4MB"
CONFIG_PARTITION_TABLE_CUSTOM_FILENAME="partitions.esp32c6.csv"
```

## XIAO-C5-Firmware/sdkconfig.defaults.esp32c5
```kconfig
# ─────────────────────────────────────────────────────────────────────────────
# Westshore Drone Remote ID Receiver — sdkconfig.defaults.esp32c5
# Target-specific overrides for ESP32-C5-WROOM-1-N8R8.
# Shared settings live in sdkconfig.defaults.
# ─────────────────────────────────────────────────────────────────────────────

CONFIG_IDF_TARGET="esp32c5"

# 8 MB flash on N8R8 module
CONFIG_ESPTOOLPY_FLASHSIZE_8MB=y
CONFIG_ESPTOOLPY_FLASHSIZE="8MB"
CONFIG_PARTITION_TABLE_CUSTOM_FILENAME="partitions.esp32c5.csv"

# 2.4 GHz band lock is applied at runtime in wifi_scanner.c via
# esp_wifi_set_band_mode(WIFI_BAND_MODE_2G_ONLY) — no build-time option
# exists in IDF 5.5.
```

## sdkconfig.defaults
```kconfig
# ─────────────────────────────────────────────────────────────────────────────
# Westshore Drone Remote ID Receiver — sdkconfig.defaults (shared)
# Target/flash/partition-table values live in sdkconfig.defaults.<target>.
# IDF version: v5.5 or later.
# ─────────────────────────────────────────────────────────────────────────────

CONFIG_PARTITION_TABLE_CUSTOM=y

# ── FreeRTOS ─────────────────────────────────────────────────────────────────
CONFIG_FREERTOS_HZ=1000
CONFIG_FREERTOS_UNICORE=n

# ── Log level ────────────────────────────────────────────────────────────────
CONFIG_LOG_DEFAULT_LEVEL_INFO=y
CONFIG_LOG_DEFAULT_LEVEL=3

# ── USB / UART console ───────────────────────────────────────────────────────
# Route IDF log output to USB-JTAG CDC — frees UART0 for JSON
CONFIG_ESP_CONSOLE_USB_SERIAL_JTAG=y
CONFIG_ESP_CONSOLE_SECONDARY_NONE=y

# ── Wi-Fi ────────────────────────────────────────────────────────────────────
CONFIG_ESP_WIFI_ENABLED=y
CONFIG_ESP_WIFI_STATIC_RX_BUFFER_NUM=4
CONFIG_ESP_WIFI_DYNAMIC_RX_BUFFER_NUM=8
CONFIG_ESP_WIFI_STATIC_TX_BUFFER=y
CONFIG_ESP_WIFI_TX_BUFFER_TYPE=0
CONFIG_ESP_WIFI_STATIC_TX_BUFFER_NUM=4
# Disable power save for continuous scanning
CONFIG_ESP_WIFI_STA_DISCONNECTED_PM_ENABLE=n
CONFIG_ESP_PHY_ENABLE_USB=y

# ── Bluetooth / NimBLE ───────────────────────────────────────────────────────
CONFIG_BT_ENABLED=y
CONFIG_BT_NIMBLE_ENABLED=y
CONFIG_BT_CONTROLLER_ENABLED=y
CONFIG_BT_NIMBLE_ROLE_CENTRAL=n
CONFIG_BT_NIMBLE_ROLE_PERIPHERAL=n
CONFIG_BT_NIMBLE_ROLE_BROADCASTER=n
CONFIG_BT_NIMBLE_ROLE_OBSERVER=y
# Enable BT5 extended advertising scanner.
# Coded PHY is pulled in via CONFIG_BT_NIMBLE_LL_CFG_FEAT_LE_CODED_PHY (set
# implicitly under BT_LE_50_FEATURE_SUPPORT); the old BT_NIMBLE_CODED_PHY
# symbol was removed in IDF 5.5.
CONFIG_BT_NIMBLE_EXT_ADV=y
# Four extended-advertising instances: handle 0 for the ODID relay broadcast,
# handle 2 for the Westshore Watch detection advertiser (manufacturer-specific
# data, company 0x08FF), and handle 3 for the node identity advertiser
# (MAC + API key, company 0x08FE).
CONFIG_BT_NIMBLE_MAX_EXT_ADV_INSTANCES=4
# BLE host task stack
CONFIG_BT_NIMBLE_HOST_TASK_STACK_SIZE=5120
# Max number of concurrent connections (1 for the GATT client)
CONFIG_BT_NIMBLE_MAX_CONNECTIONS=1
# Store BLE config in RAM (faster, no NVS wear)
CONFIG_BT_NIMBLE_NVS_PERSIST=n

# ── lwIP ─────────────────────────────────────────────────────────────────────
# Bigger socket pool so httpd can soak up Android captive-portal / Chrome
# background traffic without starving the config UI.
CONFIG_LWIP_MAX_SOCKETS=16

# ── NVS ──────────────────────────────────────────────────────────────────────
CONFIG_NVS_ENCRYPTION=n

# ── Stack sizes ───────────────────────────────────────────────────────────────
CONFIG_ESP_MAIN_TASK_STACK_SIZE=6144
CONFIG_ESP_SYSTEM_EVENT_TASK_STACK_SIZE=4096

# ── Power ────────────────────────────────────────────────────────────────────
# Disable light sleep — we need full-time RF scanning
CONFIG_PM_ENABLE=n
CONFIG_FREERTOS_USE_TICKLESS_IDLE=n

# ── Compiler optimisations ───────────────────────────────────────────────────
CONFIG_COMPILER_OPTIMIZATION_PERF=y
CONFIG_COMPILER_OPTIMIZATION_ASSERTIONS_ENABLE=y
CONFIG_MBEDTLS_SSL_PROTO_TLS1_3=n
CONFIG_MBEDTLS_SSL_RENEGOTIATION=y
```
